## configs/zynq_e200_defconfig
```kconfig
BR2_arm=y
BR2_cortex_a9=y
BR2_ARM_ENABLE_NEON=y
BR2_ARM_ENABLE_VFP=y
BR2_ARM_FPU_NEON=y
BR2_TOOLCHAIN_BUILDROOT_CXX=y
BR2_TOOLCHAIN_BUILDROOT_GLIBC=y
BR2_TOOLCHAIN_BUILDROOT_LIBC="glibc"
BR2_TOOLCHAIN_BUILDROOT_VENDOR="buildroot"
BR2_BINUTILS_EXTRA_CONFIG_OPTIONS=""
BR2_PACKAGE_GLIBC=y
BR2_PACKAGE_GLIBC_UTILS=y
BR2_GCC_VERSION_13_X=y
BR2_BINUTILS_VERSION_2_43_X=y
BR2_KERNEL_HEADERS_6_1=y
BR2_OPTIMIZE_2=y
BR2_TARGET_GENERIC_HOSTNAME="ant"
BR2_TARGET_GENERIC_ISSUE="Welcome to ANTSDR"
BR2_ROOTFS_DEVICE_CREATION_DYNAMIC_MDEV=y
BR2_TARGET_GENERIC_ROOT_PASSWD="analog"
BR2_TARGET_GENERIC_GETTY_PORT="ttyPS0"
BR2_ROOTFS_POST_BUILD_SCRIPT="board/e200/post-build.sh"
BR2_PACKAGE_ZSTD=y
# BR2_PACKAGE_LINUX_FIRMWARE is not set
BR2_PACKAGE_INPUT_EVENT_DAEMON=y
BR2_PACKAGE_UBOOT_TOOLS=y
BR2_PACKAGE_ZLIB=y
BR2_PACKAGE_LIBIIO=y
BR2_PACKAGE_LIBIIO_TESTS=y
BR2_PACKAGE_LIBIIO_BINDINGS_PYTHON=y
# BR2_PACKAGE_LIBIIO_USB_BACKEND is not set
BR2_PACKAGE_LIBIIO_IIOD=y
# BR2_PACKAGE_LIBIIO_IIOD_USBD is not set
BR2_PACKAGE_LIBGPIOD=y
BR2_PACKAGE_LIBGPIOD_TOOLS=y
BR2_PACKAGE_LIBAD9361_IIO=y
BR2_PACKAGE_LIBINI=y
BR2_PACKAGE_AVAHI=y
BR2_PACKAGE_AVAHI_DAEMON=y
BR2_PACKAGE_AVAHI_LIBDNSSD_COMPATIBILITY=y
BR2_PACKAGE_DROPBEAR=y
BR2_PACKAGE_DROPBEAR_LOCALOPTIONS_FILE="board/e200/dropbrear_localoptions.h"
BR2_PACKAGE_POLL_SYSFS=y
BR2_PACKAGE_AD936X_REF_CAL=y
BR2_PACKAGE_XILINX_FPGAUTIL=y
BR2_TARGET_ROOTFS_CPIO=y
BR2_TARGET_ROOTFS_CPIO_GZIP=y
BR2_TARGET_ROOTFS_CPIO_UIMAGE=y
BR2_TARGET_ROOTFS_EXT2=y
BR2_TARGET_ROOTFS_EXT2_4=y
BR2_TARGET_ROOTFS_EXT2_SIZE="1024M"
BR2_TARGET_ROOTFS_EXT2_MKFS_OPTIONS="-O ^64bit"
BR2_PACKAGE_HOST_DOSFSTOOLS=y
BR2_PACKAGE_HOST_GENIMAGE=y
BR2_PACKAGE_HOST_MTOOLS=y
BR2_PACKAGE_HTOP=y
BR2_PACKAGE_ETHTOOL=y
BR2_PACKAGE_ETHTOOL_PRETTY_PRINT=y
BR2_PACKAGE_BUSYBOX_CONFIG_FRAGMENT_FILES="board/e200/busybox.fragment"
BR2_PACKAGE_BUSYBOX_SHOW_OTHERS=y
BR2_PACKAGE_MTD=y
BR2_PACKAGE_MTD_MKFSJFFS2=y
BR2_PACKAGE_MTD_JFFS_UTILS=y
```

## configs/zynq_ebaz4205_defconfig
```kconfig
BR2_arm=y
BR2_cortex_a9=y
BR2_ARM_ENABLE_NEON=y
BR2_ARM_ENABLE_VFP=y
BR2_ARM_FPU_NEON=y
BR2_TOOLCHAIN_BUILDROOT_CXX=y
BR2_TOOLCHAIN_BUILDROOT_FORTRAN=y
BR2_TOOLCHAIN_BUILDROOT_GLIBC=y
BR2_TOOLCHAIN_BUILDROOT_LIBC="glibc"
BR2_TOOLCHAIN_BUILDROOT_VENDOR="buildroot"
BR2_BINUTILS_EXTRA_CONFIG_OPTIONS=""
BR2_PACKAGE_GLIBC=y
BR2_PACKAGE_GLIBC_UTILS=y
BR2_GCC_VERSION_13_X=y
BR2_GCC_ENABLE_OPENMP=y
BR2_BINUTILS_VERSION_2_43_X=y
BR2_KERNEL_HEADERS_6_12=y
BR2_OPTIMIZE_2=y
BR2_TARGET_GENERIC_HOSTNAME="ebaz4205"
BR2_TARGET_GENERIC_ISSUE="Welcome to EBAZ4205"
BR2_ROOTFS_DEVICE_CREATION_DYNAMIC_EUDEV=y
BR2_TARGET_GENERIC_ROOT_PASSWD="toor"
BR2_TARGET_GENERIC_GETTY_PORT="ttyPS1"
BR2_ROOTFS_POST_BUILD_SCRIPT="board/ebaz4205/post-build.sh"
BR2_PACKAGE_ZSTD=y
BR2_PACKAGE_MTD=y
# BR2_PACKAGE_MTD_NANDDUMP is not set
# BR2_PACKAGE_MTD_NANDTEST is not set
# BR2_PACKAGE_MTD_NANDWRITE is not set
# BR2_PACKAGE_MTD_UBIATTACH is not set
# BR2_PACKAGE_MTD_UBICRC32 is not set
# BR2_PACKAGE_MTD_UBIDETACH is not set
# BR2_PACKAGE_MTD_UBIFORMAT is not set
# BR2_PACKAGE_MTD_UBIMKVOL is not set
# BR2_PACKAGE_MTD_UBINFO is not set
# BR2_PACKAGE_MTD_UBINIZE is not set
# BR2_PACKAGE_MTD_UBIRENAME is not set
# BR2_PACKAGE_MTD_UBIRMVOL is not set
# BR2_PACKAGE_MTD_UBIRSVOL is not set
# BR2_PACKAGE_MTD_UBIUPDATEVOL is not set
# BR2_PACKAGE_MTD_UBIBLOCK is not set
# BR2_PACKAGE_LINUX_FIRMWARE is not set
BR2_PACKAGE_INPUT_EVENT_DAEMON=y
BR2_PACKAGE_UBOOT_TOOLS=y
BR2_PACKAGE_ZLIB=y
BR2_PACKAGE_LIBIIO=y
BR2_PACKAGE_LIBIIO_TESTS=y
BR2_PACKAGE_LIBIIO_BINDINGS_PYTHON=y
# BR2_PACKAGE_LIBIIO_USB_BACKEND is not set
BR2_PACKAGE_LIBIIO_IIOD=y
# BR2_PACKAGE_LIBIIO_IIOD_USBD is not set
BR2_PACKAGE_LIBGPIOD=y
BR2_PACKAGE_LIBGPIOD_TOOLS=y
BR2_PACKAGE_LIBINI=y
BR2_PACKAGE_AVAHI=y
BR2_PACKAGE_AVAHI_DAEMON=y
BR2_PACKAGE_AVAHI_LIBDNSSD_COMPATIBILITY=y
BR2_PACKAGE_DROPBEAR=y
BR2_PACKAGE_DROPBEAR_LOCALOPTIONS_FILE="board/ebaz4205/dropbrear_localoptions.h"
BR2_PACKAGE_POLL_SYSFS=y
BR2_PACKAGE_XILINX_FPGAUTIL=y
BR2_TARGET_ROOTFS_EXT2=y
BR2_TARGET_ROOTFS_EXT2_4=y
BR2_TARGET_ROOTFS_EXT2_SIZE="1024M"
BR2_TARGET_ROOTFS_EXT2_MKFS_OPTIONS="-O ^64bit"
BR2_PACKAGE_HOST_DOSFSTOOLS=y
BR2_PACKAGE_HOST_GENIMAGE=y
BR2_PACKAGE_HOST_MTOOLS=y
BR2_PACKAGE_LTRACE=y
BR2_PACKAGE_STRACE=y
BR2_PACKAGE_ELFUTILS=y
BR2_PACKAGE_BEEP=y
BR2_PACKAGE_FFTW=y
BR2_PACKAGE_FFTW_SINGLE=y
BR2_PACKAGE_FFTW_DOUBLE=y
BR2_PACKAGE_FFTW_FAST=y
BR2_PACKAGE_HTOP=y
BR2_PACKAGE_ETHTOOL=y
BR2_PACKAGE_ETHTOOL_PRETTY_PRINT=y
BR2_PACKAGE_IPERF3=y
BR2_PACKAGE_BUSYBOX_CONFIG_FRAGMENT_FILES="board/ebaz4205/busybox.fragment"
BR2_PACKAGE_BUSYBOX_SHOW_OTHERS=y
BR2_PACKAGE_VIM=y
BR2_PACKAGE_RSYNC=y
BR2_PACKAGE_GIT=y
BR2_PACKAGE_EVTEST=y
BR2_PACKAGE_IFUPDOWN=y
BR2_PACKAGE_IPROUTE2=y
BR2_PACKAGE_DEBIANUTILS=y
BR2_PACKAGE_PYTHON_BITARRAY=y
BR2_PACKAGE_PYTHON_CERTIFI=y
BR2_PACKAGE_PYTHON_CHARSET_NORMALIZER=y
BR2_PACKAGE_PYTHON_IDNA=y
BR2_PACKAGE_PYTHON_NUMPY=y
BR2_PACKAGE_PYTHON_PIP=y
BR2_PACKAGE_PYTHON_PYBIND=y
BR2_PACKAGE_PYTHON_PYYAML=y
BR2_PACKAGE_PYTHON_REQUESTS=y
BR2_PACKAGE_PYTHON_SCIPY=y
BR2_PACKAGE_PYTHON_SETUPTOOLS=y
BR2_PACKAGE_PYTHON_URLLIB3=y
BR2_PACKAGE_PYTHON_PYFFTW=y
BR2_PACKAGE_PYTHON_FAST_HISTOGRAM=y
BR2_PACKAGE_PYTHON3=y
BR2_PACKAGE_PYTHON3_BZIP2=y
BR2_PACKAGE_PYTHON3_CURSES=y
BR2_PACKAGE_PYTHON3_DECIMAL=y
BR2_PACKAGE_PYTHON3_PYEXPAT=y
BR2_PACKAGE_PYTHON3_PY_PYC=y
BR2_PACKAGE_PYTHON3_READLINE=y
BR2_PACKAGE_PYTHON3_SQLITE=y
BR2_PACKAGE_PYTHON3_SSL=y
BR2_PACKAGE_PYTHON3_UNICODEDATA=y
BR2_PACKAGE_PYTHON3_ZLIB=y
```

## package/python-fast-histogram/Config.in
```kconfig
config BR2_PACKAGE_PYTHON_FAST_HISTOGRAM
    bool "python-fast-histogram"
    depends on BR2_PACKAGE_PYTHON_NUMPY_ARCH_SUPPORTS # python-numpy
    depends on BR2_TOOLCHAIN_USES_GLIBC || BR2_TOOLCHAIN_USES_MUSL # python-numpy
    depends on BR2_TOOLCHAIN_GCC_AT_LEAST_9 # python-numpy
    depends on BR2_HOST_GCC_AT_LEAST_9 # host-python-numpy
    select BR2_PACKAGE_PYTHON_NUMPY # runtime
    help
      Sometimes you just want to compute simple 1D or 2D histograms with regular bins. Fast. No nonsense. Numpy’s histogram functions are versatile, and can handle for example non-regular binning, but this versatility comes at the expense of performance.

	  https://github.com/astrofrog/fast-histogram
```

## package/python-pyadi-iio/Config.in
```kconfig
config BR2_PACKAGE_PYTHON_PYADI_IIO
	bool "python-pyadi-iio"
    depends on BR2_PACKAGE_PYTHON_NUMPY_ARCH_SUPPORTS # python-numpy
    depends on BR2_TOOLCHAIN_USES_GLIBC || BR2_TOOLCHAIN_USES_MUSL # python-numpy
    depends on BR2_TOOLCHAIN_GCC_AT_LEAST_9 # python-numpy
    depends on BR2_HOST_GCC_AT_LEAST_9 # host-python-numpy
    select BR2_PACKAGE_PYTHON_NUMPY # runtime
    select BR2_PACKAGE_LIBIIO_BINDINGS_PYTHON
	help
      Analog Devices python interfaces for hardware with Industrial I/O drivers

	  https://github.com/analogdevicesinc/pyadi-iio
```

## package/python-pyfftw/Config.in
```kconfig
config BR2_PACKAGE_PYTHON_PYFFTW
	bool "python-pyfftw"
    depends on BR2_PACKAGE_PYTHON_NUMPY_ARCH_SUPPORTS # python-numpy
    depends on BR2_TOOLCHAIN_USES_GLIBC || BR2_TOOLCHAIN_USES_MUSL # python-numpy
    depends on BR2_TOOLCHAIN_GCC_AT_LEAST_9 # python-numpy
    depends on BR2_HOST_GCC_AT_LEAST_9 # host-python-numpy
    depends on BR2_PACKAGE_FFTW_SINGLE || BR2_PACKAGE_FFTW_DOUBLE || \
        BR2_PACKAGE_FFTW_LONG_DOUBLE || BR2_PACKAGE_FFTW_QUAD
    select BR2_PACKAGE_PYTHON_NUMPY # runtime
	help
      pyFFTW is a pythonic wrapper around FFTW 3, the speedy FFT library. The ultimate aim is to present a unified interface for all the possible transforms that FFTW can perform.

	  https://github.com/pyFFTW/pyFFTW
```
